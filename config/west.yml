## config/west.yml
```yaml
manifest:
  remotes:
    - name: zmkfirmware
      url-base: https://github.com/zmkfirmware
    - name: badjeff
      url-base: https://github.com/badjeff
  projects:
    - name: zmk
      remote: zmkfirmware
      revision: v0.3
      import: app/west.yml
    # PMW3610 ドライバ（ZMK v0.3 用のブランチ）
    - name: zmk-pmw3610-driver
      remote: badjeff
      revision: zmk-0.3
  self:
    path: config
```
