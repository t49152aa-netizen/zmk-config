#include "my_keyboard.dtsi"

/*
 * 左手 (XIAO nRF52840) ピンアサイン ※回路図より
 *   D0  : IRQ      (トラックボール用・今は未使用)
 *   D1  : row0     D2 : row1     D3 : row2     D6 : row3
 *   D4  : SPI_SCK  D5 : SPI_MOSI (トラックボール用・今は未使用)
 *   D10 : col0     D9 : col1     D8 : col2     D7 : col3
 *   NFC2(P0.10) : col4
 *   NFC1(P0.09) : SPI_CS (トラックボール用・今は未使用)
 *   SWDIO       : col5  ← nRF52840 の SWDIO は専用ピンで GPIO にできないため未定義
 */

&kscan0 {
    row-gpios
        = <&xiao_d 1 GPIO_ACTIVE_HIGH>   /* row0 */
        , <&xiao_d 2 GPIO_ACTIVE_HIGH>   /* row1 */
        , <&xiao_d 3 GPIO_ACTIVE_HIGH>   /* row2 */
        , <&xiao_d 6 GPIO_ACTIVE_HIGH>   /* row3 */
        ;
    col-gpios
        = <&xiao_d 10 (GPIO_ACTIVE_HIGH | GPIO_PULL_DOWN)>  /* col0 */
        , <&xiao_d 9  (GPIO_ACTIVE_HIGH | GPIO_PULL_DOWN)>  /* col1 */
        , <&xiao_d 8  (GPIO_ACTIVE_HIGH | GPIO_PULL_DOWN)>  /* col2 */
        , <&xiao_d 7  (GPIO_ACTIVE_HIGH | GPIO_PULL_DOWN)>  /* col3 */
        , <&gpio0 10  (GPIO_ACTIVE_HIGH | GPIO_PULL_DOWN)>  /* col4 = NFC2 */
        ;
};
