#include "my_keyboard.dtsi"

/*
 * 右手: ハードが未確定のため仮で左と同じピンを入れてある。
 * 右手の回路図が決まったらピンを合わせること。
 */

&default_transform {
    col-offset = <6>;
};

&kscan0 {
    row-gpios
        = <&xiao_d 1 GPIO_ACTIVE_HIGH>
        , <&xiao_d 2 GPIO_ACTIVE_HIGH>
        , <&xiao_d 3 GPIO_ACTIVE_HIGH>
        , <&xiao_d 6 GPIO_ACTIVE_HIGH>
        ;
    col-gpios
        = <&xiao_d 10 (GPIO_ACTIVE_HIGH | GPIO_PULL_DOWN)>
        , <&xiao_d 9  (GPIO_ACTIVE_HIGH | GPIO_PULL_DOWN)>
        , <&xiao_d 8  (GPIO_ACTIVE_HIGH | GPIO_PULL_DOWN)>
        , <&xiao_d 7  (GPIO_ACTIVE_HIGH | GPIO_PULL_DOWN)>
        , <&gpio0 10  (GPIO_ACTIVE_HIGH | GPIO_PULL_DOWN)>
        ;
};
